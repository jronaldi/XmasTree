## main/Kconfig.projbuild
```kconfig
menu "XmasTree Configuration"

    config EXAMPLE_FORMAT_IF_MOUNT_FAILED
        bool "Format the card if mount failed"
        default n
        help
            If this config item is set, format_if_mount_failed will be set to true and the card will be formatted if
            the mount has failed.

    config EXAMPLE_FORMAT_SD_CARD
        bool "Format the card as a part of the example"
        default n
        help
            If this config item is set, the card will be formatted as a part of the example.

    config EXAMPLE_PIN_MOSI
        int "MOSI GPIO number"
        default 15 if IDF_TARGET_ESP32
        default 35 if IDF_TARGET_ESP32S2
        default 35 if IDF_TARGET_ESP32S3
        default 5  if IDF_TARGET_ESP32H2
        default 4  # C3 and others

    config EXAMPLE_PIN_MISO
        int "MISO GPIO number"
        default 2 if IDF_TARGET_ESP32
        default 37 if IDF_TARGET_ESP32S2
        default 37 if IDF_TARGET_ESP32S3
        default 0  if IDF_TARGET_ESP32H2
        default 6  # C3 and others

    config EXAMPLE_PIN_CLK
        int "CLK GPIO number"
        default 14 if IDF_TARGET_ESP32
        default 36 if IDF_TARGET_ESP32S2
        default 36 if IDF_TARGET_ESP32S3
        default 4  if IDF_TARGET_ESP32H2
        default 5  # C3 and others

    config EXAMPLE_PIN_CS
        int "CS GPIO number"
        default 13 if IDF_TARGET_ESP32
        default 34 if IDF_TARGET_ESP32S2
        default 34 if IDF_TARGET_ESP32S3
        default 1  # C3 and others
    
    config XTREE_GPIO_LOADREG
        int "PIN controlling the REGISTER load"
        help
            Pin that controls the LOAD signal of the RGB and LEVELS registers.
        default 27
       
    config XTREE_GPIO_RED
        int "PIN controlling the RED component"
        help
            Pin that defines the RED component for all LEDs.
        default 17

    config XTREE_GPIO_GREEN
        int "PIN controlling the GREEN component"
        help
            Pin that defines the GREEN component for all LEDs.
        default 14
    
    config XTREE_GPIO_BLUE
        int "PIN controlling the BLUE component"
        help
            Pin that defines the BLUE component for all LEDs.
        default 27

    config XTREE_GPIO_LEVEL1
        int "PIN controlling LED row LEVEL 1"
        help
            Pin that defines the GPIO that powers all LEDs on level 1.
        default 26

    config XTREE_GPIO_LEVEL2
        int "PIN controlling LED row LEVEL 2"
        help
            Pin that defines the GPIO that powers all LEDs on level 2.
        default 25

    config XTREE_GPIO_LEVEL3
        int "PIN controlling LED row LEVEL 3"
        help
            Pin that defines the GPIO that powers all LEDs on level 3.
        default 33

    config XTREE_GPIO_LEVEL4
        int "PIN controlling LED row LEVEL 4"
        help
            Pin that defines the GPIO that powers all LEDs on level 4.
        default 32

    config XTREE_GPIO_LEVEL5
        int "PIN controlling LED row LEVEL 5"
        help
            Pin that defines the GPIO that powers all LEDs on level 5.
        default 0

    config XTREE_GPIO_LEVEL6
        int "PIN controlling LED row LEVEL 6"
        help
            Pin that defines the GPIO that powers all LEDs on level 6.
        default 16

    config XTREE_GPIO_LEVEL7
        int "PIN controlling LED row LEVEL 7"
        help
            Pin that defines the GPIO that powers all LEDs on level 7.
        default 4

    config XTREE_GPIO_LEVEL8
        int "PIN controlling LED row LEVEL 8"
        help
            Pin that defines the GPIO that powers all LEDs on level 8.
        default 22
    
        
endmenu
```
